## src/Kconfig.projbuild
```kconfig
menu "Oxebots Robot Configuration"

    choice FIRMWARE_ROLE
        prompt "Firmware target role"
        default FIRMWARE_ROLE_ROBOT
        help
            Select whether this binary runs on an SSL robot PCB or on the
            USB-connected ESP32 DevKit Base Station.

        config FIRMWARE_ROLE_ROBOT
            bool "SSL Robot"
            help
                Standard robot firmware driving motors, sensors, kicker and radio.

        config FIRMWARE_ROLE_BASE_STATION
            bool "USB Base Station"
            help
                Dedicated ESP32 DevKit base station bridging UART0 COBS+Bitproto
                frames to the nRF24L01+ radio network.
    endchoice

    config BASE_STATION_UART_BAUD
        int "Base Station UART0 baud rate"
        depends on FIRMWARE_ROLE_BASE_STATION
        default 921600
        help
            Baud rate for binary COBS+CRC8 communication between PC and Base Station.

    config GPIO_MAX_INDEX
        int "Maximum GPIO number for the target board"
        default 39 if IDF_TARGET_ESP32
        default 48 if IDF_TARGET_ESP32S3

    config DISABLE_SAFE_STOP
        bool "Disable SAFE_STOP and report health faults as warnings"
        default n
        help
            Report health faults as warnings without blocking valid radio
            or USB wheel commands. Report DISARMED when a radio command
            expires. Command timeouts and actuator prerequisites still apply.

    menu "Radio (nRF24L01)"

        config IRQ_GPIO
            int "IRQ GPIO"
            range 0 GPIO_MAX_INDEX
            default 4 if IDF_TARGET_ESP32
            help
                GPIO connected to the nRF24L01 IRQ output.
                Schematic net: IRQRF24.
                ESP32 pin: GPIO4.

        config RETRANSMIT_COUNT
            int "Retransmit Count"
            range 0 15
            default 15 if IDF_TARGET_ESP32
            help
                Number of automatic retransmissions after a failed
                transmission. A value of 0 disables retransmission.

        config NRF24_SPI_DEVICE_KEY
            int "SPI device key"
            range 0 255
            default 253
            help
                Software key used by the shared SPI driver. The radio uses
                manual chip-select (CSNRF24), so this is not a GPIO number.

        config RADIO_REPLY_DELAY_US
            int "Robot telemetry reply turnaround delay (microseconds)"
            range 0 10000
            default 500
            help
                Short pause before a robot transmits an uplink reply so the ESP32
                base station finishes switching from transmit to receive mode.

        config RADIO_CHANNEL_HUNT_TRIGGER_MS
            int "Robot channel-hunt trigger after communication loss (ms)"
            range 1000 60000
            default 15000
            help
                Duration without base-station packets before the robot cycles
                through rendezvous channels to rediscover the base station.

        config RADIO_CHANNEL_HUNT_DWELL_MS
            int "Robot channel-hunt dwell time per channel (ms)"
            range 50 5000
            default 300
            help
                Time spent listening on each candidate channel during rendezvous hunting.

    endmenu

    menu "I2C"

        config SDA_GPIO
            int "I2C SDA GPIO"
            range 0 GPIO_MAX_INDEX
            default 21 if IDF_TARGET_ESP32
            help
                GPIO for the I2C serial-data line.
                Schematic net: SDAI2C.
                ESP32 pin: GPIO21.

        config SCL_GPIO
            int "I2C SCL GPIO"
            range 0 GPIO_MAX_INDEX
            default 22 if IDF_TARGET_ESP32
            help
                GPIO for the I2C serial-clock line.
                Schematic net: SCLI2C.
                ESP32 pin: GPIO22.

        config I2C_PORT_NUM
            int "I2C Port Number"
            range 0 1
            default 0 if IDF_TARGET_ESP32
            help
                ESP32 hardware I2C controller number.

    endmenu

    menu "74HC595 Shift Register"

        config SHIFT_REGISTER_LATCH_GPIO
            int "74HC595 RCKSR latch GPIO"
            range 0 GPIO_MAX_INDEX
            default 17 if IDF_TARGET_ESP32
            help
                GPIO connected to the 74HC595 RCKSR latch input.
                Schematic net: RCKSR.
                ESP32 pin: GPIO17.

        config SHIFT_REGISTER_DEVICE_KEY
            int "SPI device key"
            range 0 255
            default 254
            help
                Software key used by the shared SPI driver. The 74HC595 has
                no chip-select input, so this is not a GPIO number.

        config SHIFT_REGISTER_DIR1_BIT
            int "M1 direction output bit"
            range 0 7
            default 0

        config SHIFT_REGISTER_DIR2_BIT
            int "M2 direction output bit"
            range 0 7
            default 1

        config SHIFT_REGISTER_DIR3_BIT
            int "M3 direction output bit"
            range 0 7
            default 2

        config SHIFT_REGISTER_DIR4_BIT
            int "M4 direction output bit"
            range 0 7
            default 3

        config SHIFT_REGISTER_MUX_A_BIT
            int "4052 A select output bit"
            range 0 7
            default 4

        config SHIFT_REGISTER_MUX_B_BIT
            int "4052 B select output bit"
            range 0 7
            default 5

        config SHIFT_REGISTER_MUX_INH_BIT
            int "4052 inhibit output bit"
            range 0 7
            default 6

        config SHIFT_REGISTER_RF_CE_BIT
            int "nRF24L01 CE output bit"
            range 0 7
            default 7
            help
                74HC595 output bit wired to the nRF24L01 CE input. On this
                board the radio CE line is driven by shifting the register
                and latching it, not by a direct GPIO.
                Schematic net: CERF24.
                74HC595 output: QH (bit 7).

    endmenu

    menu "Motor Interfaces"

        menu "Front Left (M1)"

            config MOTOR_FL_FB_GPIO
                int "Feedback GPIO"
                range 0 GPIO_MAX_INDEX
                default 25 if IDF_TARGET_ESP32
                help
                    Digital feedback input from motor M1.
                    Schematic net: FBM1.
                    ESP32 pin: GPIO25.

            config MOTOR_FL_PWM_GPIO
                int "PWM GPIO"
                range 0 GPIO_MAX_INDEX
                default 32 if IDF_TARGET_ESP32
                help
                    PWM output for motor M1.
                    Schematic net: PWMM1.
                    ESP32 pin: GPIO32.

            config MOTOR_FL_ENC_CHANNEL
                int "Encoder ADC1 Channel"
                range 0 7
                default 0 if IDF_TARGET_ESP32
                help
                    Analog encoder input for motor M1.
                    Schematic net: ENCM1.
                    ADC1 Channel 0 corresponds to GPIO36.

        endmenu

        menu "Back Left (M2)"

            config MOTOR_BL_FB_GPIO
                int "Feedback GPIO"
                range 0 GPIO_MAX_INDEX
                default 27 if IDF_TARGET_ESP32
                help
                    Digital feedback input from motor M2.
                    Schematic net: FBM2.
                    ESP32 pin: GPIO27.

            config MOTOR_BL_PWM_GPIO
                int "PWM GPIO"
                range 0 GPIO_MAX_INDEX
                default 26 if IDF_TARGET_ESP32
                help
                    PWM output for motor M2.
                    Schematic net: PWMM2.
                    ESP32 pin: GPIO26.

            config MOTOR_BL_ENC_CHANNEL
                int "Encoder ADC1 Channel"
                range 0 7
                default 7 if IDF_TARGET_ESP32
                help
                    Analog encoder input for motor M2.
                    Schematic net: ENCM2.
                    ADC1 Channel 7 corresponds to GPIO35.

        endmenu

        menu "Back Right (M3)"

            config MOTOR_BR_FB_GPIO
                int "Feedback GPIO"
                range 0 GPIO_MAX_INDEX
                default 13 if IDF_TARGET_ESP32
                help
                    Digital feedback input from motor M3.
                    Schematic net: FBM3.
                    ESP32 pin: GPIO13.

            config MOTOR_BR_PWM_GPIO
                int "PWM GPIO"
                range 0 GPIO_MAX_INDEX
                default 14 if IDF_TARGET_ESP32
                help
                    PWM output for motor M3.
                    Schematic net: PWMM3.
                    ESP32 pin: GPIO14.

            config MOTOR_BR_ENC_CHANNEL
                int "Encoder ADC1 Channel"
                range 0 7
                default 6 if IDF_TARGET_ESP32
                help
                    Analog encoder input for motor M3.
                    Schematic net: ENCM3.
                    ADC1 Channel 6 corresponds to GPIO34.

        endmenu

        menu "Front Right (M4)"

            config MOTOR_FR_FB_GPIO
                int "Feedback GPIO"
                range 0 GPIO_MAX_INDEX
                default 2 if IDF_TARGET_ESP32
                help
                    Digital feedback input from motor M4.
                    Schematic net: FBM4.
                    ESP32 pin: GPIO2.

            config MOTOR_FR_PWM_GPIO
                int "PWM GPIO"
                range 0 GPIO_MAX_INDEX
                default 12 if IDF_TARGET_ESP32
                help
                    PWM output for motor M4.
                    Schematic net: PWMM4.
                    ESP32 pin: GPIO12.

            config MOTOR_FR_ENC_CHANNEL
                int "Encoder ADC1 Channel"
                range 0 7
                default 3 if IDF_TARGET_ESP32
                help
                    Analog encoder input for motor M4.
                    Schematic net: ENCM4.
                    ADC1 Channel 3 corresponds to GPIO39.

        endmenu

        menu "Pulse Feedback"

            config MOTOR_PWM_FREQ_HZ
                int "Motor PWM frequency (Hz)"
                range 500 40000
                default 5000
                help
                    PWM carrier frequency sent to the four BL48250 motor
                    drivers. Lowering from 20 kHz to 5 kHz can be tested on
                    the bench to check deadzone and low-speed linearity.

            config MOTOR_FB_COUNTS_PER_REV
                int "Counts per motor revolution"
                range 1 10000
                default 10 if IDF_TARGET_ESP32
                help
                    Number of pulse-counter increments per motor-shaft
                    revolution. The counter increments on both edges of the
                    feedback net (rising and falling), matching the Arduino
                    reference sketch, so the default is 10 counts per motor
                    revolution (5 square-wave cycles). The wheel shaft turns
                    WHEEL_REDUCTION times slower than the motor shaft.

        endmenu

    endmenu

    menu "Analog Monitoring"

        config VMON_ADC_CHANNEL
            int "VMON ADC1 Channel"
            range 0 7
            default 5 if IDF_TARGET_ESP32
            help
                ADC1 channel used to measure the monitored supply voltage.
                Schematic net: Vmon.
                ADC1 Channel 5 corresponds to GPIO33.

        config VMON_SUPPLY_RATIO_MILLI
            int "VMON pin-to-supply ratio (milli)"
            range 1 100000
            default 26455
            help
                Supply voltage = VMON pin voltage x ratio / 1000. The VMON net
                divides the battery voltage with a 56k series resistor and a
                2k2 shunt resistor: ratio = (56 + 2.2) / 2.2 = 26.4545, so the
                24 V battery shows about 0.907 V on the pin.

        config VMON_UNDERVOLTAGE_MV
            int "VMON undervoltage threshold (mV)"
            range 0 60000
            default 19800
            help
                Supply voltage below this value flags undervoltage in the
                serial debug health stream. The battery is a 6S2P pack of
                18650 lithium ion cells, so 19.8 V is 3.3 V per cell, the
                usual discharged alarm point well above the cell damage
                floor of 18.0 V (3.0 V per cell).

        config VMON_OVERVOLTAGE_MV
            int "VMON overvoltage threshold (mV)"
            range 0 60000
            default 26500
            help
                Supply voltage above this value flags overvoltage in the
                serial debug health stream. A fully charged 6S2P 18650 pack
                sits at 25.2 V (4.2 V per cell), so 26.5 V leaves margin.

        config ADC_SAMPLE_FREQ_HZ
            int "ADC acquisition aggregate sample rate (Hz)"
            range 20000 2000000
            default 160000
            help
                Total conversions per second shared by all scan table
                slots. With the default weights the four encoder channels
                occupy 12 of the 13 slots and VMON one, so each encoder
                channel converts at 3/13 of this rate and VMON at 1/13.
                The production default is 160 kHz:
                the encoder acquisition benchmark showed twice the publish
                rate with the same analog noise band and no missed frames.
                Higher rates give the encoder channels more conversions
                per revolution but cost dispatch-task CPU and add noise;
                the AdcStream boot log prints the per-channel rates.

        config ADC_OVERSAMPLE
            int "ADC oversample factor (mean of N conversions per channel)"
            range 1 256
            default 32
            help
                Every sampled channel publishes the mean of N consecutive
                conversions instead of single samples, trading update rate
                for noise: each channel publishes at its conversion rate
                divided by N (the AdcStream boot log prints the
                per-channel conversion rates of the weighted scan table).
                Blocks whose sample spread exceeds half of the ADC range
                straddled a wrapping channel discontinuity (the AS5600
                encoder output wraps once per motor revolution) and are
                discarded instead of published.

    endmenu

    menu "GY-85 Interrupts"

        config GY85_AINT1_GPIO
            int "Accelerometer INT1 GPIO"
            range 0 GPIO_MAX_INDEX
            default 5 if IDF_TARGET_ESP32
            help
                Interrupt input from the GY-85 accelerometer.
                Schematic net: AINT1.
                ESP32 pin: GPIO5.

        config GY85_GINT_GPIO
            int "Gyroscope interrupt GPIO"
            range 0 GPIO_MAX_INDEX
            default 15 if IDF_TARGET_ESP32
            help
                Interrupt input from the GY-85 gyroscope.
                Schematic net: GINT.
                ESP32 pin: GPIO15.

        config GY85_MDRDY_GPIO
            int "Magnetometer data-ready GPIO"
            range 0 GPIO_MAX_INDEX
            default 16 if IDF_TARGET_ESP32
            help
                Interrupt input from the GY-85 magnetometer data-ready output.
                Schematic net: MDRDY.
                ESP32 pin: GPIO16.

    endmenu

    menu "Time-of-Flight Sensor"

        config TOF_INT_GPIO
            int "VL53L5CX interrupt GPIO"
            range 0 GPIO_MAX_INDEX
            default 1 if IDF_TARGET_ESP32
            help
                Interrupt input from the VL53L5CX sensor.
                Schematic net: INTTOF.
                ESP32 pin: GPIO1.

    endmenu

    menu "Encoder Acquisition"

        config ENCODER_DIAG
            bool "Encoder and motor control timing diagnostics"
            default n
            help
                Enable for encoder acquisition and motor control benchmarks.
                Collect sample counts, timing, and overruns in the encoder
                acquisition and motor control loops. Report summaries about
                every 10 seconds.

    endmenu

    menu "Serial Debug Dashboard"

        config SERIAL_DEBUG
            bool "Enable serial debug dashboard"
            default n
            help
                Compile in the SerialDebug service. When a dashboard client
                opens the serial port and sends a START_STREAM control frame,
                the firmware streams binary debug frames over UART0. Streaming
                stops automatically when keepalives stop arriving, so a closed
                port means no debug traffic.

    endmenu

endmenu
```
