## sdkconfig.defaults
```kconfig
#
# System
#
CONFIG_BLINK_GPIO=2

#
# I2C
#
CONFIG_SDA_GPIO=21
CONFIG_SCL_GPIO=22
CONFIG_I2C_PORT_NUM=0

#
# SPI
#
CONFIG_MISO_GPIO=19
CONFIG_MOSI_GPIO=23
CONFIG_SCLK_GPIO=18

#
# Motors
#

# Front Left (M1)
CONFIG_MOTOR_FL_DIR_GPIO=33
CONFIG_MOTOR_FL_PWM_GPIO=32
CONFIG_MOTOR_FL_ENC_CHANNEL=0
# Back Left (M2)
CONFIG_MOTOR_BL_DIR_GPIO=25
CONFIG_MOTOR_BL_PWM_GPIO=26
CONFIG_MOTOR_BL_ENC_CHANNEL=7
# Back Right (M3)
CONFIG_MOTOR_BR_DIR_GPIO=27
CONFIG_MOTOR_BR_PWM_GPIO=14
CONFIG_MOTOR_BR_ENC_CHANNEL=6
# Front Right (M4)
CONFIG_MOTOR_FR_DIR_GPIO=17
CONFIG_MOTOR_FR_PWM_GPIO=16
CONFIG_MOTOR_FR_ENC_CHANNEL=3

#
# nRF24L01 Configuration
#
CONFIG_GPIO_RANGE_MAX=33
CONFIG_RADIO_CHANNEL=76
CONFIG_MISO_GPIO=19
CONFIG_SCLK_GPIO=18
CONFIG_MOSI_GPIO=23
CONFIG_CE_GPIO=2
CONFIG_CSN_GPIO=5
CONFIG_IRQ_GPIO=4
CONFIG_SPI2_HOST=y
# CONFIG_SPI3_HOST is not set
CONFIG_ADVANCED=y
# CONFIG_RF_RATIO_2M is not set
# CONFIG_RF_RATIO_1M is not set
CONFIG_RF_RATIO_250K=y
CONFIG_RETRANSMIT_DELAY=4
CONFIG_RETRANSMIT_COUNT=3
```

## src/Kconfig.projbuild
```kconfig
menu "Oxebots Robot Configuration"

    config GPIO_MAX_INDEX
        int "Maximum GPIO number for the target board"
        default 39 if IDF_TARGET_ESP32
        default 48 if IDF_TARGET_ESP32S3

    menu "System"
        config BLINK_GPIO
            int "Blink LED GPIO"
            range 0 GPIO_MAX_INDEX
            default 2 if IDF_TARGET_ESP32
            help
                GPIO number for the onboard or status LED.
    endmenu

    menu "Radio (nRF24L01)"
        config IRQ_GPIO
            int "IRQ GPIO"
            range 0 GPIO_MAX_INDEX
            default 15 if IDF_TARGET_ESP32
            help
                GPIO connected to the nRF24L01 IRQ pin (active low).

        config RETRANSMIT_COUNT
            int "Retransmit Count"
            range 0 15
            default 3 if IDF_TARGET_ESP32
            help
                Number of retransmissions for failed transmissions (0-15).
                A value of 0 means disabled, while 15 means up to 15 retransmissions.
    endmenu

    menu "I2C"
        config SDA_GPIO
            int "I2C SDA GPIO"
            range 0 GPIO_MAX_INDEX
            default 21 if IDF_TARGET_ESP32
            help
                GPIO for I2C Serial Data line.

        config SCL_GPIO
            int "I2C SCL GPIO"
            range 0 GPIO_MAX_INDEX
            default 22 if IDF_TARGET_ESP32
            help
                GPIO for I2C Serial Clock line.

        config I2C_PORT_NUM
            int "I2C Port Number"
            range 0 1
            default 0 if IDF_TARGET_ESP32
            help
                I2C Port number to use (0 or 1 on ESP32).
    endmenu

    menu "Motors"
        menu "Front Left (M1)"
            config MOTOR_FL_DIR_GPIO
                int "Direction GPIO"
                range 0 GPIO_MAX_INDEX
                default 33 if IDF_TARGET_ESP32
                help
                    Output pin for Front Left motor (M1) direction.
            
            config MOTOR_FL_PWM_GPIO
                int "PWM GPIO"
                range 0 GPIO_MAX_INDEX
                default 32 if IDF_TARGET_ESP32
                help
                    Output pin for Front Left motor (M1) speed (PWM).

            config MOTOR_FL_ENC_CHANNEL
                int "Encoder ADC Channel (ADC1)"
                range 0 9
                default 0 if IDF_TARGET_ESP32
                help
                    ADC1 Channel Number for Front Left motor (M1).
                    Available ADC1 channels on ESP32:
                        Channel 0 -> GPIO 36 (VP)
                        Channel 1 -> UNUSABLE (GPIO 37)
                        Channel 2 -> UNUSABLE (GPIO 38)
                        Channel 3 -> GPIO 39 (VN)
                        Channel 4 -> GPIO 32
                        Channel 5 -> GPIO 33
                        Channel 6 -> GPIO 34
                        Channel 7 -> GPIO 35
        endmenu

        menu "Back Left (M2)"
            config MOTOR_BL_DIR_GPIO
                int "Direction GPIO"
                range 0 GPIO_MAX_INDEX
                default 25 if IDF_TARGET_ESP32
                help
                    Output pin for Back Left motor (M2) direction.
            
            config MOTOR_BL_PWM_GPIO
                int "PWM GPIO"
                range 0 GPIO_MAX_INDEX
                default 26 if IDF_TARGET_ESP32
                help
                    Output pin for Back Left motor (M2) speed (PWM).

            config MOTOR_BL_ENC_CHANNEL
                int "Encoder ADC Channel (ADC1)"
                range 0 7
                default 7 if IDF_TARGET_ESP32
                help
                    ADC1 Channel Number for Back Left motor (M2).
                    Available ADC1 channels on ESP32:
                        Channel 0 -> GPIO 36 (VP)
                        Channel 1 -> UNUSABLE (GPIO 37)
                        Channel 2 -> UNUSABLE (GPIO 38)
                        Channel 3 -> GPIO 39 (VN)
                        Channel 4 -> GPIO 32
                        Channel 5 -> GPIO 33
                        Channel 6 -> GPIO 34
                        Channel 7 -> GPIO 35
        endmenu

        menu "Back Right (M3)"
            config MOTOR_BR_DIR_GPIO
                int "Direction GPIO"
                range 0 GPIO_MAX_INDEX
                default 27 if IDF_TARGET_ESP32
                help
                    Output pin for Back Right motor (M3) direction.
            config MOTOR_BR_PWM_GPIO
                int "PWM GPIO"
                range 0 GPIO_MAX_INDEX
                default 14 if IDF_TARGET_ESP32
                help
                    Output pin for Back Right motor (M3) speed (PWM).

            config MOTOR_BR_ENC_CHANNEL
                int "Encoder ADC Channel (ADC1)"
                range 0 7
                default 6 if IDF_TARGET_ESP32
                help
                    ADC1 Channel Number for Back Right motor (M3).
                    Available ADC1 channels on ESP32:
                        Channel 0 -> GPIO 36 (VP)
                        Channel 1 -> UNUSABLE (GPIO 37)
                        Channel 2 -> UNUSABLE (GPIO 38)
                        Channel 3 -> GPIO 39 (VN)
                        Channel 4 -> GPIO 32
                        Channel 5 -> GPIO 33
                        Channel 6 -> GPIO 34
                        Channel 7 -> GPIO 35
        endmenu

        menu "Front Right (M4)"
            config MOTOR_FR_DIR_GPIO
                int "Direction GPIO"
                range 0 GPIO_MAX_INDEX
                default 17 if IDF_TARGET_ESP32
                help
                    Output pin for Front Right motor (M4) direction.
            
            config MOTOR_FR_PWM_GPIO
                int "PWM GPIO"
                range 0 GPIO_MAX_INDEX
                default 16 if IDF_TARGET_ESP32
                help
                    Output pin for Front Right motor (M4) speed (PWM).

            config MOTOR_FR_ENC_CHANNEL
                int "Encoder ADC Channel (ADC1)"
                range 0 7
                default 3 if IDF_TARGET_ESP32
                help
                    ADC1 Channel Number for Front Right motor (M4).
                    Available ADC1 channels on ESP32:
                        Channel 0 -> GPIO 36 (VP)
                        Channel 1 -> UNUSABLE (GPIO 37)
                        Channel 2 -> UNUSABLE (GPIO 38)
                        Channel 3 -> GPIO 39 (VN)
                        Channel 4 -> GPIO 32
                        Channel 5 -> GPIO 33
                        Channel 6 -> GPIO 34
                        Channel 7 -> GPIO 35
        endmenu

    endmenu

endmenu
```
