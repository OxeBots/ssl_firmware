## src/esp_link/Kconfig.projbuild
```kconfig
menu "ESP Link Configuration"

    config ESP_NOW_CHANNEL
        int "ESP-NOW Wi-Fi channel"
        range 1 13
        default 6
        help
            Use the same channel as the robot firmware.

endmenu
```
